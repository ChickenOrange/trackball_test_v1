/*
 * Copyright (c) 2021, Yonatan Schachter
 * SPDX-License-Identifier: Apache-2.0
 */

#include <zephyr/dt-bindings/pinctrl/rpi-pico-rp2040-pinctrl.h>

&pinctrl {
	//uart0_default: uart0_default {
	//	group1 {
	//		pinmux = <UART0_TX_P0>;/*UART0_TX 巧 0俊 且寸*/
	//	};
	//	group2 {
	//		pinmux = <UART0_RX_P1>;/*UART0_RX 巧 1俊 且寸*/
	//		input-enable;/*涝仿 扁瓷 劝己*/
	//	};
	//};

	//i2c0_default: i2c0_default {
	//	group1 {
	//		pinmux = <I2C0_SDA_P4>, <I2C0_SCL_P5>;/*I2C0_SDA 巧4俊 且寸, I2CO_SCL 巧5俊 且寸*/
	//		input-enable;
	//		input-schmitt-enable;
	//	};
	//};

	//spi0_default: spi0_default {
	//	group1 {
	//		pinmux = <SPI0_CSN_P17>, <SPI0_SCK_P18>, <SPI0_TX_P19>;
	//	};
	//	group2 {
	//		pinmux = <SPI0_RX_P16>;
	//		input-enable;
	//	};
	//};

	//adc_default: adc_default {
	//	group1 {
	//		pinmux = <ADC_CH0_P26>, <ADC_CH1_P27>, <ADC_CH2_P28>, <ADC_CH3_P29>;
	//		input-enable;
	//	};
	//};
};
