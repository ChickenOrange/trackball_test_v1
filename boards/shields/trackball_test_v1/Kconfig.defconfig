## boards/shields/trackball_test_v1/Kconfig.defconfig
```kconfig
if SHIELD_TRACKBALL_TEST_V1

# Name must be less than 16 characters long!
config ZMK_KEYBOARD_NAME
    default "Trackball v1"

endif
```

## boards/shields/trackball_test_v1/Kconfig.shield
```kconfig
# No whitespace after the comma or in your keyboard name!
config SHIELD_TRACKBALL_TEST_V1
    def_bool $(shields_list_contains,trackball_test_v1)
```

## boards/shields/trackball_test_v1/boards/waveshare_rp2040_zero.conf
```kconfig
CONFIG_CONSOLE=n
CONFIG_SERIAL=n
CONFIG_UART_CONSOLE=n
CONFIG_ZMK_USB=y

# USB activate
CONFIG_USB_DEVICE_STACK=y
CONFIG_USB_DC_RPI_PICO=y
CONFIG_USB_DEVICE_HID=y
CONFIG_USB=y
```
